## conf/layer.conf
```bitbake
# We have a conf and classes directory, append to BBPATH
BBPATH .= ":${LAYERDIR}"

# We have recipes-* directories, add to BBFILES
BBFILES += "${LAYERDIR}/recipes-*/*/*.bb ${LAYERDIR}/recipes-*/*/*.bbappend"

BBFILE_COLLECTIONS += "connected-brewery"
BBFILE_PATTERN_connected-brewery = "^${LAYERDIR}/"
BBFILE_PRIORITY_connected-brewery = "24"

# Let us add layer-specific bbappends which are only applied when that
# layer is included in our configuration
BBFILES += "${@' '.join('${LAYERDIR}/%s/recipes*/*/*.bbappend' % layer \
               for layer in BBFILE_COLLECTIONS.split())}"
# Add layer-specific bb files too
BBFILES += "${@' '.join('${LAYERDIR}/%s/recipes*/*/*.bb' % layer \
               for layer in BBFILE_COLLECTIONS.split())}"

LAYERDEPENDS_connected-brewery = " \
    core \
    yocto \
    openembedded-layer gnome-layer multimedia-layer networking-layer \
    browser-layer \
    freescale-layer \
    fsl-demos \
    lxde-layer \
    qt5-layer \
"
LAYERSERIES_COMPAT_connected-brewery = "sumo thud"
```
